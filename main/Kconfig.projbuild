## main/Kconfig.projbuild
```kconfig
menu "*** EvLamp configuration ***"

	config EL_EFFECT_DEFAULT
		int "Default effect"
		default 1
		
	config EL_FPS_DEFAULT
		int "Default FPS"
		range 1 100
		default 60

	config EL_BRIGHTNESS_DEFAULT
		int "Default brightness"
		range 1 255
		default 255

	menu "Default WiFi configuration"
		
		choice WIFI_MODE_C
			prompt "Default WiFi mode"
			default EL_WIFI_MODE_AP

			config EL_WIFI_MODE_AP
				bool "Access point"

			config EL_WIFI_MODE_STA
				bool "Station"

		endchoice

		menu "Access point mode"
		
			config EL_WIFI_AP_SSID
				string "SSID"
				default "EvLamp"
				
			config EL_WIFI_AP_PASSWD
				string "Password"
				default ""
	
			config EL_WIFI_AP_CHANNEL
				int "Channel"
				range 0 13
				default 6

		endmenu

		menu "Station mode"
		
			config EL_WIFI_STA_SSID
				string "SSID"
				default "MyHomeWIFI"
				
			config EL_WIFI_STA_PASSWD
				string "Password"
				default "MyPassword"
	
		endmenu

		config EL_WIFI_DHCP
			bool "Enable DHCP"
			default y
			
		config EL_WIFI_IP
			string "IP address"
			default "192.168.1.1"

		config EL_WIFI_NETMASK
			string "Netmask"
			default "255.255.255.0"

		config EL_WIFI_GATEWAY
			string "Gateway"
			default "192.168.1.1"
			
		config EL_WIFI_DNS
			string "DNS server"
			default "192.168.1.1"
			
	endmenu
	
	menu "Hardware configuration"
	
		menu "LED matrix"
	
			config EL_MATRIX_WIDTH
				int "Width of single LED matrix block"
				range 8 128
				default 16
		
			config EL_MATRIX_HEIGHT
				int "Height of single LED matrix block"
				range 8 128
				default 16

			config EL_MATRIX_H_BLOCKS
				int "Number of blocks (LED matrices) horizontally"
				range 1 8
				default 1

			config EL_MATRIX_V_BLOCKS
				int "Number of blocks (LED matrices) vertically"
				range 1 8
				default 1

			menu "GPIO for blocks"

                config EL_MATRIX_GPIO_0
                    int "GPIO output for block (LED matrix) 0"
                    range 0 39
                    default 5

                config EL_MATRIX_GPIO_1
                    int "GPIO output for block (LED matrix) 1"
                    range 0 39
                    default 17

                config EL_MATRIX_GPIO_2
                    int "GPIO output for block (LED matrix) 2"
                    range 0 39
                    default 16

                config EL_MATRIX_GPIO_3
                    int "GPIO output for block (LED matrix) 3"
                    range 0 39
                    default 4

                config EL_MATRIX_GPIO_4
                    int "GPIO output for block (LED matrix) 4"
                    range 0 39
                    default 2

                config EL_MATRIX_GPIO_5
                    int "GPIO output for block (LED matrix) 5"
                    range 0 39
                    default 15

                config EL_MATRIX_GPIO_6
                    int "GPIO output for block (LED matrix) 6"
                    range 0 39
                    default 8

                config EL_MATRIX_GPIO_7
                    int "GPIO output for block (LED matrix) 7"
                    range 0 39
                    default 7

			endmenu

			choice EL_LED_TYPE_C
				prompt "LED type"
				default EL_LED_TYPE_WS2812
				
				config EL_LED_TYPE_WS2812
					bool "WS2812"
	
				config EL_LED_TYPE_SK6812
					bool "SK6812"
	
				config EL_LED_TYPE_APA106
					bool "APA106"

				config EL_LED_TYPE_SM16703
					bool "SM16703"
			endchoice

			config EL_SINGLE_LED_CURRENT_MA
				int "Maximal current consuming by single pixel, mA (see in datasheet)"
				default 33

			config EL_MATRIX_MAX_CURRENT
				int "Restrict maximal current consuming by all LEDs, mA"
				default 5000

		endmenu

		menu "Buttons configuration"
			
			config EL_BUTTON_LEVEL
				int "Button logic level for 'pressed' state"
				range 0 1
				default 1

			config EL_BUTTON_RESET_LEVEL
				int "Logic level of reset button for 'pressed' state"
				range 0 1
				default 0

			config EL_BUTTON_PULLUPDOWN
				bool "Enable internal pullup/pulldown resistor"
				default y

			config EL_BUTTON_MAIN_GPIO
				int "'Main' button GPIO pin"
				range 0 39
				default 25
			
			config EL_BUTTON_UP_GPIO
				int "'Up' button GPIO pin"
				range 0 39
				default 26

			config EL_BUTTON_DOWN_GPIO
				int "'Down' button GPIO pin"
				range 0 39
				default 27

			config EL_BUTTON_RESET_GPIO
				int "'Reset' button GPIO pin"
				range 0 39
				default 0

		endmenu

#		config EL_SDCARD_ENABLE
#			bool "Use SD card connected to SPI"
#			default y
#
#		menu "SD card configuration"
#		depends on EL_SDCARD_ENABLE
#			
#			config EL_SDCARD_MISO
#				int "MISO (D0) GPIO pin"
#				depends on EL_SDCARD_ENABLE
#				range 0 39
#				default 19
#
#			config EL_SDCARD_MOSI
#				int "MOSI (CMD) GPIO pin"
#				depends on EL_SDCARD_ENABLE
#				range 0 39
#				default 22
#				
#			config EL_SDCARD_SCK
#				int "SCK (CLK) GPIO pin"
#				depends on EL_SDCARD_ENABLE
#				range 0 39
#				default 18
#
#			config EL_SDCARD_CS
#				int "CS (D3) GPIO pin"
#				depends on EL_SDCARD_ENABLE
#				range 0 39
#				default 21
#			
#			config EL_SDCARD_CD
#				int "CD (Card Detect) GPIO pin"
#				depends on EL_SDCARD_ENABLE
#				range 0 39
#				default 23
#
#		endmenu


	endmenu

endmenu
```

## sdkconfig.defaults
```kconfig
CONFIG_FREERTOS_HZ=1000
CONFIG_PARTITION_TABLE_CUSTOM=y
CONFIG_PARTITION_TABLE_CUSTOM_FILENAME="partitions.csv"

CONFIG_COMPILER_OPTIMIZATION_PERF=y

CONFIG_BUTTON_POLL_TIMEOUT=50
CONFIG_BUTTON_LONG_PRESS_TIMEOUT=2000
CONFIG_BUTTON_AUTOREPEAT_TIMEOUT=500
CONFIG_BUTTON_AUTOREPEAT_INTERVAL=250

CONFIG_ESP_DEFAULT_CPU_FREQ_MHZ_240=y
CONFIG_ESP_DEFAULT_CPU_FREQ_MHZ=240

CONFIG_RMT_SUPPRESS_DEPRECATE_WARN=y

CONFIG_ESPTOOLPY_FLASHMODE_QIO=y
CONFIG_ESPTOOLPY_FLASHMODE="qio"
CONFIG_ESPTOOLPY_FLASHFREQ_80M=y
CONFIG_ESPTOOLPY_FLASHFREQ="80m"
CONFIG_ESPTOOLPY_FLASHSIZE_4MB=y
CONFIG_ESPTOOLPY_FLASHSIZE="4MB"
```
